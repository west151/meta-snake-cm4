## conf/layer.conf
```bitbake
# We have a conf and classes directory, append to BBPATH
BBPATH .= ":${LAYERDIR}"

# We have a recipes directory containing .bb and .bbappend files, add to BBFILES
BBFILES += "${LAYERDIR}/recipes*/*/*.bb \
            ${LAYERDIR}/recipes*/*/*.bbappend"

BBFILE_COLLECTIONS += "snake-pi4"
BBFILE_PATTERN_snake-pi4 := "^${LAYERDIR}/"
BBFILE_PRIORITY_snake-pi4 = "9"

LAYERSERIES_COMPAT_snake-pi4 = "warrior zeus dunfell gatesgarth hardknott"

# Additional license directories.
LICENSE_PATH += "${LAYERDIR}/files/custom-licenses"

# The dynamic-layers directory hosts the extensions and layer specific
# modifications.
#
# The .bbappend and .bb files are included if the respective layer
# collection is available.
#BBFILES += "${@' '.join('${LAYERDIR}/dynamic-layers/%s/recipes*/*/*.bbappend' % layer \
#               for layer in BBFILE_COLLECTIONS.split())}"
#BBFILES += "${@' '.join('${LAYERDIR}/dynamic-layers/%s/recipes*/*/*.bb' % layer \
#               for layer in BBFILE_COLLECTIONS.split())}"

#BBFILES_DYNAMIC += " \
#    openembedded-layer:${LAYERDIR}/dynamic-layers/openembedded-layer/*/*/*.bb \
#    openembedded-layer:${LAYERDIR}/dynamic-layers/openembedded-layer/*/*/*.bbappend \
#   networking-layer:${LAYERDIR}/dynamic-layers/networking-layer/*/*/*.bb \
#    networking-layer:${LAYERDIR}/dynamic-layers/networking-layer/*/*/*.bbappend \
#    qt5-layer:${LAYERDIR}/dynamic-layers/qt5-layer/*/*/*.bb \
#    qt5-layer:${LAYERDIR}/dynamic-layers/qt5-layer/*/*/*.bbappend \
#"
```
